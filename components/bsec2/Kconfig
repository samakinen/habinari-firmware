## components/bsec2/Kconfig
```kconfig
# SPDX-License-Identifier: GPL-3.0-or-later
# Copyright (C) 2025-2026 Sami Mäkinen

menu "BME688 air quality (BSEC)"

    config BME688_USE_BSEC
        bool "Enable Bosch BSEC air-quality fusion for BME688"
        default n
        help
            Compile the BSEC integration that turns the BME688 raw gas signal
            into IAQ / CO2-equivalent / breath-VOC-equivalent outputs. Requires
            the proprietary Bosch BSEC library and headers to be installed under
            components/bsec2/bosch/ (see components/bsec2/README.md). The library
            is NOT redistributable and is therefore not committed to this
            repository. When disabled the firmware builds with no air-quality
            outputs and no external dependency.

    config BME688_BSEC_SAMPLE_RATE_ULP
        bool "Use ULP (~300 s) sample rate instead of LP (~3 s)"
        depends on BME688_USE_BSEC
        default n
        help
            LP (low power, ~3 s cycle) gives responsive IAQ at higher power draw.
            ULP (ultra-low power, ~300 s) minimises power for battery use at the
            cost of responsiveness.

    config BME688_BSEC_STATE_SAVE_INTERVAL_MIN
        int "BSEC calibration-state save interval (minutes, 0 = never)"
        depends on BME688_USE_BSEC
        default 60
        help
            How often the BSEC calibration state is persisted to NVS so the gas
            baseline and accuracy survive reboots. State is only saved once BSEC
            reports high accuracy.

endmenu
```

## components/knx_tp_bit_bang/Kconfig.projbuild
```kconfig
menu "KNX TP Bit Bang Configuration"

    config KNX_TP_TX_PIN
        int "KNX TP TX GPIO Pin"
        range 0 48
        default 4
        help
            GPIO pin number for KNX TP transmission.
            Using compile-time constants enables maximum optimization.

    config KNX_TP_RX_PIN
        int "KNX TP RX GPIO Pin"
        range 0 48
        default 5
        help
            GPIO pin number for KNX TP reception.
            Using compile-time constants enables maximum optimization.

    config KNX_DEBUG_GPIO
        bool "Enable Debug GPIO for Logic Analyzer"
        default n
        help
            Enable debug GPIO toggling for logic analyzer debugging.
            This adds overhead to ISR execution and should be disabled in production.

    config KNX_DEBUG_GPIO_PIN
        int "Debug GPIO Pin"
        range 0 48
        default 20
        depends on KNX_DEBUG_GPIO
        help
            GPIO pin number for debug output to logic analyzer.

    config KNX_OPTIMIZE_ISR
        bool "Enable ISR optimizations"
        default y
        help
            Enable compiler optimizations and branch prediction hints for ISR functions.
            Recommended for production builds.

    config KNX_USE_DIRECT_GPIO
        bool "Use Direct GPIO Register Access"
        default y
        help
            Use direct register access instead of gpio_set_level() for maximum performance.
            Provides 5-20x faster GPIO operations in ISR context.

    config KNX_ENABLE_TASK_NOTIFICATIONS
        bool "Enable Task Notifications from ISR"
        default n
        help
            Enable task notifications from ISR context. Disable for maximum ISR performance.
            When disabled, task notification code is completely compiled out.

    config KNX_ENABLE_COLLISION_DETECTION
        bool "Enable Bus Collision Detection"
        default n
        help
            Enable collision detection in RX ISR. Disable for maximum performance.
            When disabled, collision detection code is compiled out.

    config KNX_ENABLE_ADVANCED_OPTIMIZATIONS
        bool "Enable Advanced Performance Optimizations"
        default y
        help
            Enable advanced optimizations like lookup tables, branch prediction hints,
            and memory access pattern optimization. Recommended for production.

endmenu
```
